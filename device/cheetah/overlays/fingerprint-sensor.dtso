// SPDX-License-Identifier: MIT
/*
 * Bring-up only (FINGERPRINT-PLAN.md, gate F6): enable the sub-PMIC (for
 * the sensor's supply, S2MPG13 LDO15S) and the Goodix sensor node. Apply
 * on top of aoc-core-test.dtso or fingerprint-trusty.dtso (Trusty). The
 * PERIC0 pin controller (the sensor's reset line, gpp1-1) is already on in
 * the default DTB. goodix_fp stays blacklisted from autoload
 * (omandroid-fingerprint.conf). Paths, not labels, so the base DTB needs
 * no __symbols__.
 */
/dts-v1/;
/plugin/;

&{/firmware/power-management/pmic-2} {
	status = "okay";
};

&{/fingerprint} {
	status = "okay";
};
