// SPDX-License-Identifier: MIT
/*
 * Bring-up only (MODEM-PLAN.md 6.3): the S5300's packet processor, on top
 * of modem-cpif-test (apply it after that overlay, never alone). Stock's
 * cpif node values: four downlink queues in the PKTPROC region, each on its
 * own MSI block (1-4) of the modem's PCIe link, and two uplink queues (one
 * for TCP ACKs only) in PKTPROC_UL; all three parts of both cached, the link
 * being I/O coherent.
 *
 * Needs a kernel with CONFIG_CP_PKTPROC and CONFIG_CP_PKTPROC_UL; without
 * this overlay such a kernel runs the modem on the legacy buffers.
 */
/dts-v1/;
/plugin/;

&{/cpif} {
	pktproc_cp_base = <0x0 0x20000000>;

	pktproc_dl_support = <1>;
	pktproc_dl_version = <2>;
	pktproc_dl_info_rgn_offset = <0x0>;
	pktproc_dl_info_rgn_size = <0x1000>;
	pktproc_dl_desc_rgn_offset = <0x1000>;
	pktproc_dl_desc_rgn_size = <0xff000>;
	pktproc_dl_buff_rgn_offset = <0x100000>;
	pktproc_dl_buff_rgn_size = <0x1b00000>;
	pktproc_dl_info_rgn_cached = <1>;
	pktproc_dl_desc_rgn_cached = <1>;
	pktproc_dl_buff_rgn_cached = <1>;
	pktproc_dl_desc_mode = <1>;
	pktproc_dl_num_queue = <4>;
	pktproc_dl_use_exclusive_irq = <1>;
	pktproc_dl_use_hw_iocc = <1>;
	pktproc_dl_max_packet_size = <0x630>;
	pktproc_dl_use_dedicated_baaw = <0>;

	pktproc_ul_support = <1>;
	pktproc_ul_info_rgn_offset = <0x1c00000>;
	pktproc_ul_info_rgn_size = <0x1000>;
	pktproc_ul_desc_rgn_offset = <0x1c01000>;
	pktproc_ul_desc_rgn_size = <0x8f000>;
	pktproc_ul_buff_rgn_offset = <0x1c90000>;
	pktproc_ul_buff_rgn_size = <0x370000>;
	pktproc_ul_padding_required = <1>;
	pktproc_ul_num_queue = <2>;
	pktproc_ul_max_packet_size = <0x800>;
	pktproc_ul_hiprio_ack_only = <1>;
	pktproc_ul_info_rgn_cached = <1>;
	pktproc_ul_desc_rgn_cached = <1>;
	pktproc_ul_buff_rgn_cached = <1>;
	pktproc_ul_use_hw_iocc = <1>;
};
