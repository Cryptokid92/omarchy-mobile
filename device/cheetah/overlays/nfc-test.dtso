// SPDX-License-Identifier: MIT
/*
 * Bring-up only (RADIOS-CAMERA-PLAN.md section 3, stage N2): turn on the HSI1
 * pin controller (the NFC reset line is gph1-5) and the ST54J's NFC
 * controller node at 0x08 on I2C 8, so st-nci can bind. st_nci_i2c is
 * blacklisted (omandroid-nfc.conf) and the runbook loads it by hand. The
 * node's reference clock (the PMU's CLKOUT1 pad) is in the base DT and is
 * only switched on while the controller is powered up. The eSE side of the
 * chip is not described and is never touched. Applied with fdtoverlay;
 * paths, not labels.
 */
/dts-v1/;
/plugin/;

&{/soc@0/pinctrl@11840000} {
	status = "okay";
};

&{/soc@0/usi@109700c0/i2c@10970000/nfc@8} {
	status = "okay";
};
