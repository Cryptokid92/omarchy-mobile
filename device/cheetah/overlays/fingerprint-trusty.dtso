// SPDX-License-Identifier: MIT
/*
 * Bring-up only (FINGERPRINT-RESEARCH.md, gate F2): enable the Trusty node,
 * so the trusty modules can bind. They stay blacklisted from autoload
 * (omamobile-device-cheetah: modprobe.d/omamobile-fingerprint.conf) and are
 * loaded by hand. Applied to the built gs201-cheetah.dtb with fdtoverlay.
 * Paths, not labels, so the base DTB needs no __symbols__.
 */
/dts-v1/;
/plugin/;

&{/trusty} {
	status = "okay";
};
