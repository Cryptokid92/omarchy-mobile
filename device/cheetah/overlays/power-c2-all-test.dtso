// SPDX-License-Identifier: MIT
/*
 * Bring-up only (POWER-PLAN.md, gate C2): C2 core power-down on all eight
 * cores. Apply on top of power-mct-test.dtso. All three states go together:
 * cpuidle-psci registers nothing if any CPU lacks an idle state.
 */
/dts-v1/;
/plugin/;

&{/cpus/idle-states/cpu-ananke-sleep} {
	status = "okay";
};

&{/cpus/idle-states/cpu-hercules-sleep} {
	status = "okay";
};

&{/cpus/idle-states/cpu-hera-sleep} {
	status = "okay";
};
