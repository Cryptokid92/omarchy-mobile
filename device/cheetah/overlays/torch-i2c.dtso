// SPDX-License-Identifier: MIT
/*
 * Bring-up only (HAPTICS-TORCH-PLAN.md, gate T1): USI15 as I2C (Google's
 * bus 15: LM3644TT at 0x63, held in shutdown by HWEN; camera EEPROM at
 * 0x50) and the PERIC0 pin controller that owns HWEN (gpp8-2).
 */
/dts-v1/;
/plugin/;

&{/soc@0/pinctrl@10840000} {
	status = "okay";
};

&{/soc@0/usi@10da00c0} {
	status = "okay";
};

&{/soc@0/usi@10da00c0/i2c@10da0000} {
	status = "okay";
};
